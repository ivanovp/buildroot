## package/python-mpd2/Config.in
```kconfig
config BR2_PACKAGE_PYTHON_MPD2
	bool "python-mpd2"
	help
      Python library which provides a client interface for the Music Player Daemon.

      https://pypi.org/project/python-mpd2/
```
